## config/boards/shields/HPD/Kconfig.defconfig
```kconfig
if SHIELD_HPD_RIGHT

config ZMK_KEYBOARD_NAME
	default "HPD"

config ZMK_SPLIT_ROLE_CENTRAL
	default y

endif

if SHIELD_HPD_LEFT || SHIELD_HPD_RIGHT

config ZMK_SPLIT
	default y
	
endif
```

## config/boards/shields/HPD/Kconfig.shield
```kconfig
config SHIELD_HPD_LEFT
    def_bool $(shields_list_contains,HPD_left)

config SHIELD_HPD_RIGHT
    def_bool $(shields_list_contains,HPD_right)
```

## config/west.yml
```yaml
manifest:
  remotes:
    - name: zmkfirmware
      url-base: https://github.com/zmkfirmware
    - name: tangbonze
      url-base: https://github.com/tangbonze
    - name: caksoylar
      url-base: https://github.com/caksoylar
  projects:
    - name: zmk
      remote: zmkfirmware
      revision: v0.3
      import: app/west.yml
    - name: zmk-pmw3610-driver
      remote: tangbonze
      revision: main
    - name: zmk-pointing-acceleration
      remote: caksoylar
      revision: main
  self:
    path: config
```
